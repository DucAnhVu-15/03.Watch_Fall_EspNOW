## 01.Watch_Master/main/Kconfig.projbuild
```kconfig
menu "Watch Fall - Master"

    config WF_MASTER_AUTOSTART
        bool "Tự bắt đầu ghi khi khởi động"
        default y

    config WF_BUTTON_GPIO
        int "GPIO nút START/STOP"
        default 0
        help
            XIAO ESP32-S3: nút BOOT = GPIO0 (tích cực mức thấp).

    config WF_MASTER_DUMP_CSV
        bool "In dữ liệu CSV ra console"
        default n
        help
            In từng mẫu ra log với tiền tố "S," (Slave) và "M," (Master).
            Tạm thay cho việc ghi LittleFS để kiểm tra dữ liệu trên PC.

endmenu
```

## 03.Watch_Collection/main/Kconfig.projbuild
```kconfig
menu "Watch Fall - Collection (SD)"

    config WF_BTN_START_GPIO
        int "GPIO nút START"
        default 3
        help
            XIAO ESP32-C3: D1 = GPIO3. Nút nối xuống GND, dùng pull-up nội.

    config WF_BTN_STOP_GPIO
        int "GPIO nút STOP"
        default 5
        help
            XIAO ESP32-C3: D3 = GPIO5. Nút nối xuống GND, dùng pull-up nội.

    config WF_SD_MOSI_GPIO
        int "GPIO MOSI"
        default 10
        help
            XIAO ESP32-C3: D10 = GPIO10.

    config WF_SD_MISO_GPIO
        int "GPIO MISO"
        default 9
        help
            XIAO ESP32-C3: D9 = GPIO9 (chân strapping, cũng là nút BOOT).

    config WF_SD_SCK_GPIO
        int "GPIO SCK"
        default 8
        help
            XIAO ESP32-C3: D8 = GPIO8 (chân strapping).

    config WF_SD_CS_GPIO
        int "GPIO CS"
        default 20
        help
            XIAO ESP32-C3: D7 = GPIO20.

    config WF_SD_FREQ_KHZ
        int "Tốc độ SPI của thẻ SD (kHz)"
        range 400 20000
        default 4000
        help
            4 MHz đã đủ dư cho khoảng 8 kB/s và ít kén dây nối.

    config WF_STORE_QUEUE_LEN
        int "Số khung chờ ghi trong RAM"
        range 4 64
        default 16
        help
            16 khung bằng khoảng 8 giây dữ liệu của 2 node.

    config WF_STORE_SYNC_MS
        int "Chu kỳ fsync (ms)"
        range 500 10000
        default 2000
        help
            Nếu mất nguồn trước khi bấm STOP, phần chưa fsync sẽ mất. Chu kỳ ngắn
            hơn thì an toàn hơn nhưng ghi thẻ nhiều hơn.

    config WF_STORE_SELFTEST
        bool "Tự kiểm tra ghi SD bằng dữ liệu giả của 2 node"
        default n
        help
            Chỉ để thử thẻ SD, không cần 2 đồng hồ: từ lúc bấm START đến lúc bấm
            STOP, sinh khung giả của 2 node và bỏ qua dữ liệu thật qua ESP-NOW.
            Khi đóng file sẽ đọc lại để đối chiếu số dòng.

endmenu
```

## components/wf_imu/Kconfig
```kconfig
menu "Watch Fall - IMU source"

    choice WF_IMU_BACKEND
        prompt "Nguồn dữ liệu IMU"
        default WF_IMU_BACKEND_ULP if ULP_COPROC_TYPE_RISCV
        default WF_IMU_BACKEND_SIM

        config WF_IMU_BACKEND_ULP
            bool "MMA8451 thật, ULP RISC-V đọc FIFO"
            depends on ULP_COPROC_TYPE_RISCV

        config WF_IMU_BACKEND_SIM
            bool "Giả lập (sóng sin, không cần cảm biến)"
    endchoice

    config WF_IMU_I2C_ADDR
        hex "Địa chỉ I2C của MMA8451"
        depends on WF_IMU_BACKEND_ULP
        default 0x1C
        help
            0x1C khi SA0 = GND, 0x1D khi SA0 = VCC.

    config WF_IMU_SDA_GPIO
        int "GPIO SDA (RTC I2C)"
        depends on WF_IMU_BACKEND_ULP
        default 3
        help
            ESP32-S3: RTC I2C chỉ có SDA trên GPIO1 hoặc GPIO3.

    config WF_IMU_SCL_GPIO
        int "GPIO SCL (RTC I2C)"
        depends on WF_IMU_BACKEND_ULP
        default 2
        help
            ESP32-S3: RTC I2C chỉ có SCL trên GPIO0 hoặc GPIO2.

    config WF_IMU_INT1_GPIO
        int "GPIO nối chân INT1 của MMA8451"
        depends on WF_IMU_BACKEND_ULP
        default 4
        help
            Phải là RTC GPIO (GPIO0-21 trên ESP32-S3).

    config WF_IMU_FIFO_WATERMARK
        int "FIFO watermark (số mẫu)"
        depends on WF_IMU_BACKEND_ULP
        range 1 32
        default 25
        help
            Số mẫu trong FIFO thì kích INT1. 25 mẫu @100Hz = 1 batch mỗi 250 ms.
            FIFO chỉ chứa 32 mẫu nên cần chừa chỗ cho thời gian ULP đọc.

    config WF_IMU_ULP_POLL_US
        int "Chu kỳ ULP kiểm tra INT1 (us)"
        depends on WF_IMU_BACKEND_ULP
        range 1000 50000
        default 2000
        help
            Càng ngắn thì mốc thời gian của mỗi batch càng ít rung.

    config WF_IMU_TEST_ONLY
        bool "Chỉ đọc IMU và in log, không chạy ESP-NOW"
        depends on WF_IMU_BACKEND_ULP
        default n
        help
            app_main chỉ khởi động cảm biến và ULP rồi in từng mẫu 3 trục ra log.
            Dùng khi cần kiểm tra cảm biến mà không có C3.

    config WF_SIM_ODR_ERR_PPM
        int "Sai số ODR giả lập (ppm)"
        range -50000 50000
        default 0
        help
            Chỉ dùng cho nguồn giả lập.
            Mô phỏng dao động nội của IMU chạy lệch (MMA8451 lệch vài %).
            Ví dụ 5000 = chậm hơn 0.5%.

endmenu
```

## components/wf_node/Kconfig
```kconfig
menu "Watch Fall - Node"

    config WF_NODE_ID
        int "Node ID (1 = Master, tay phải; 2 = Slave, tay trái)"
        range 1 2
        default 1
        help
            Quyết định tên file trên thẻ SD và khe gửi sau beacon. 2 node phải khác
            ID nhau; giá trị được đặt sẵn trong sdkconfig.defaults của từng project.

endmenu
```

## components/wf_proto/Kconfig
```kconfig
menu "Watch Fall - Common"

    config WF_ESPNOW_CHANNEL
        int "ESP-NOW Wi-Fi channel"
        range 1 13
        default 1
        help
            Hai node và C3 phải dùng cùng kênh.

    config WF_SAMPLE_RATE_HZ
        int "IMU sample rate (Hz)"
        range 10 400
        default 100

    config WF_FRAME_MS
        int "Độ dài mỗi khung (ms)"
        range 200 2000
        default 1000
        help
            Khung chia theo đồng hồ chung nên số mẫu mỗi khung thay đổi theo ODR
            thật của cảm biến. Tổng số mẫu phải vừa 1 gói ESP-NOW v2 (1470 byte).

    config WF_OVERLAP_SAMPLES
        int "Số mẫu cũ gửi dư (overlap)"
        range 0 20
        default 10

    config WF_BEACON_MS
        int "Chu kỳ beacon của C3 (ms)"
        range 50 1000
        default 100
        help
            Beacon dùng để đồng bộ thời gian, đồng thời mở khe gửi cho node.
            Sửa thì phải nạp lại cả 3 thiết bị.

    choice WF_PHY_RATE
        prompt "Tốc độ PHY của gói dữ liệu"
        default WF_PHY_RATE_6M
        help
            Khung khoảng 750 byte: 1 Mbps mất khoảng 6 ms, 6 Mbps khoảng 1 ms trên
            sóng. Tốc độ cao hơn thì phát nhanh hơn nhưng chịu kém khi cơ thể chắn sóng.

        config WF_PHY_RATE_1M
            bool "1 Mbps"
        config WF_PHY_RATE_6M
            bool "6 Mbps"
        config WF_PHY_RATE_12M
            bool "12 Mbps"
        config WF_PHY_RATE_24M
            bool "24 Mbps"
    endchoice

    config WF_SYNC_TEST
        bool "Bật test độ chính xác đồng bộ bằng dây GPIO"
        default n
        help
            Nối 1 dây GPIO và GND từ C3 tới cả 2 node. C3 đảo mức chân mỗi 500 ms,
            mỗi node bắt cạnh, quy về đồng hồ chung rồi báo lại. C3 log chênh lệch
            giữa 2 node, chính là sai số đồng bộ thực tế.

    config WF_SYNC_TEST_GPIO
        int "GPIO dùng cho test đồng bộ"
        depends on WF_SYNC_TEST
        default 21 if IDF_TARGET_ESP32C3
        default 5
        help
            C3: pad 7 = D6 = GPIO21. S3: D4 = GPIO5.
            Không dùng GPIO2/3/4 của S3 vì đã nối MMA8451.

endmenu
```

## components/wf_sbuf/Kconfig
```kconfig
menu "Watch Fall - Sample buffer"

    config WF_SBUF_CAPACITY
        int "Dung lượng ring buffer (số mẫu)"
        range 256 8192
        default 1024
        help
            Mỗi mẫu 16 byte. 1024 mẫu @100Hz ~ 10 giây dữ liệu, 16KB RAM.

endmenu
```
